## package/mandatory/Config.in
```kconfig
config BR2_PACKAGE_TRAINING_MANDATORY
	bool "Minimum setting to have something running"
	select BR2_PACKAGE_XZ
	select BR2_PACKAGE_KMOD
	select BR2_PACKAGE_KMOD_TOOLS
	select BR2_PACKAGE_HOST_KMOD_XZ
	select BR2_PACKAGE_DROPBEAR
	select BR2_TOOLCHAIN_BUILDROOT_CXX
	help
	  Install some tools:
	   - xz, kmod for kernel modules loading
	   - dropbear for ssh
	  SDK:
	   - add C++ support

config BR2_PACKAGE_TRAINING_WIFI
	bool "package for Wifi and Hotspot"
	select BR2_PACKAGE_WPA_SUPPLICANT
	select BR2_PACKAGE_HOSTAPD
	select BR2_PACKAGE_DNSMASQ
	select BR2_PACKAGE_IPTABLES
	help
	  Install:
	   - wpa_supplication
	   - hostapd
	   - dnsmasq
	   - iptables

config BR2_PACKAGE_TRAINING_UBOOT
	bool "Enable u-Boot"
	select BR2_TARGET_UBOOT
	select BR2_PACKAGE_HOST_UBOOT_TOOLS_BOOT_SCRIPT
	select BR2_PACKAGE_HOST_UBOOT_TOOLS

config BR2_TARGET_UBOOT_BOARD_DEFCONFIG
	default "rpi_3_32b" if BR2_LINUX_KERNEL_DEFCONFIG="bcm2709"
	default "rpi_4" if BR2_LINUX_KERNEL_DEFCONFIG="bcm2711"

config BR2_TARGET_UBOOT_CONFIG_FRAGMENT_FILES
	default "$(BR2_EXTERNAL_TRAINING_PATH)/board/raspberrypi/uboot-rpi3_b_plus.frag" if BR2_LINUX_KERNEL_DEFCONFIG="bcm2709"

config BR2_PACKAGE_HOST_UBOOT_TOOLS_BOOT_SCRIPT_SOURCE
	default "$(BR2_EXTERNAL_TRAINING_PATH)/board/raspberrypi3/uboot_rpi3-b.txt" if BR2_LINUX_KERNEL_DEFCONFIG="bcm2709"
	default "$(BR2_EXTERNAL_TRAINING_PATH)/board/raspberrypi3/uboot_rpi4.txt" if BR2_LINUX_KERNEL_DEFCONFIG="bcm2711"
```
